## CMakeLists.txt
```
# SPDX-License-Identifier: Apache-2.0

cmake_minimum_required(VERSION 3.20.0)

find_package(Zephyr REQUIRED HINTS $ENV{ZEPHYR_BASE})
project(wifi)

FILE(GLOB app_sources CONFIGURE_DEPENDS src/*.c)
target_sources(app PRIVATE ${app_sources})
```

## prj.conf
```kconfig
CONFIG_EARLY_CONSOLE=y

CONFIG_NETWORKING=y
CONFIG_TEST_RANDOM_GENERATOR=y

CONFIG_NET_TX_STACK_SIZE=2048
CONFIG_NET_RX_STACK_SIZE=2048

CONFIG_NET_PKT_RX_COUNT=10
CONFIG_NET_PKT_TX_COUNT=10
CONFIG_NET_BUF_RX_COUNT=20
CONFIG_NET_BUF_TX_COUNT=20
CONFIG_NET_MAX_CONTEXTS=10
CONFIG_NET_DHCPV4=y
CONFIG_NET_DHCPV6=y

CONFIG_NET_IPV4=y
CONFIG_NET_IPV6=y

CONFIG_NET_TCP=y
CONFIG_NET_SOCKETS=y
CONFIG_DNS_RESOLVER=y
CONFIG_HTTP_CLIENT=y

CONFIG_NET_LOG=y
CONFIG_INIT_STACKS=y

CONFIG_NET_SHELL=y

CONFIG_NET_STATISTICS=y
CONFIG_NET_STATISTICS_PERIODIC_OUTPUT=n

CONFIG_WIFI=y
CONFIG_WIFI_LOG_LEVEL_ERR=y
CONFIG_NET_L2_WIFI_SHELL=y

# Config
CONFIG_FLASH=y
CONFIG_NVS=y
CONFIG_SETTINGS=y
CONFIG_SETTINGS_NVS=y
```

## socs/esp32c3.conf
```kconfig
CONFIG_WIFI=y

CONFIG_NETWORKING=y
CONFIG_NET_L2_ETHERNET=y

CONFIG_NET_IPV6=n
CONFIG_NET_IPV4=y
CONFIG_NET_DHCPV4=y
CONFIG_NET_DHCPV6=y
CONFIG_ESP32_WIFI_STA_AUTO_DHCPV4=y

CONFIG_NET_LOG=y
```

## boards/esp32_devkitm.overlay
```dts
/ {
	chosen {
		zephyr,console = &usb_serial;
		zephyr,shell-console = &usb_serial;
	}
};
```

## src/main.c
```c
#include "nvs_config.h"
#include "wifi.h"
#include "creds.h"
#include <string.h>

int main() {
    init_nvs();
    init_wifi();

    struct my_config_wifi_entry wf_conf = {
        .psk = CRED_PSK,
        .ssid = CRED_SSID,
    };
    wf_conf.psk_len = strlen(wf_conf.psk);
    wf_conf.ssid_len = strlen(wf_conf.ssid);

    wifi_connect(&wf_conf);
}
```

## src/http_get.c
```c
/* 
 * Copyright (c) 2023 Craig Peacock.
 * 
 * API Information:
 * https://docs.zephyrproject.org/3.2.0/connectivity/networking/api/http.html
 *
 * SPDX-License-Identifier: Apache-2.0
 */

#include "http_get.h"
#include <stdio.h>
#include <stdlib.h>
#include <zephyr/net/socket.h>
#include <zephyr/kernel.h>
#include <zephyr/net/http/client.h>

void nslookup(const char *hostname, struct zsock_addrinfo **results) {
  int err;

  struct zsock_addrinfo hints = {
      //.ai_family = AF_INET,     // Allow IPv4 Address
      .ai_family = AF_UNSPEC,        // Allow IPv4 or IPv6
      .ai_socktype = SOCK_STREAM,
  };

  err = zsock_getaddrinfo(hostname, "8080", &hints, (struct zsock_addrinfo **) results);
  if (err) {
    printf("getaddrinfo() failed, err %d\n", errno);
    return;
  }
}

void print_addrinfo_results(struct zsock_addrinfo *rp) {
  char ipv4[INET_ADDRSTRLEN];
  char ipv6[INET6_ADDRSTRLEN];
  struct sockaddr_in *sa;
  struct sockaddr_in6 *sa6;

  for (; rp != NULL; rp = rp->ai_next) {
    if (rp->ai_addr->sa_family == AF_INET) {
      // IPv4 Address
      sa = (struct sockaddr_in *) rp->ai_addr;
      zsock_inet_ntop(AF_INET, &sa->sin_addr, ipv4, INET_ADDRSTRLEN);
      printf("IPv4: %s\n", ipv4);
    }
    if (rp->ai_addr->sa_family == AF_INET6) {
      // IPv6 Address
      sa6 = (struct sockaddr_in6 *) rp->ai_addr;
      zsock_inet_ntop(AF_INET6, &sa6->sin6_addr, ipv6, INET6_ADDRSTRLEN);
      printf("IPv6: %s\n", ipv6);
    }
  }
}

int connect_socket(struct zsock_addrinfo **results) {
  int sock;
  struct zsock_addrinfo *rp;
  struct sockaddr_in *sa;

  // Create Socket
  sock = zsock_socket(AF_INET, SOCK_STREAM, IPPROTO_TCP);
  if (sock < 0) {
    printk("Error creating socket\n");
    return (-1);
  }

  // Iterate through until we get a successful connection
  for (rp = (struct zsock_addrinfo *) results; rp != NULL; rp = rp->ai_next) {
    if (rp->ai_addr->sa_family == AF_INET) {
      // IPv4 Address
      sa = (struct sockaddr_in *) rp->ai_addr;
      sa->sin_port = htons(80);
      zsock_connect(sock, (struct sockaddr *) sa, sizeof(struct sockaddr_in));
      if (sock > 0)
        break;
    }
  }

  return (sock);
}

static void http_response_cb(struct http_response *rsp,
                             enum http_final_call final_data,
                             void *user_data) {
  if (final_data == HTTP_DATA_MORE) {
    printk("Partial data received (%zd bytes)\n", rsp->data_len);
  } else if (final_data == HTTP_DATA_FINAL) {
    printk("All the data received (%zd bytes)\n", rsp->data_len);
  }

  printk("Bytes Recv %zd\n", rsp->data_len);
  printk("Response status %s\n", rsp->http_status);
  printk("Recv Buffer Length %zd\n", rsp->recv_buf_len);
  printk("%s\n", rsp->recv_buf);
}

void http_get(int sock, char *hostname, char *url) {
  struct http_request req = {0};
  static uint8_t recv_buf[512];
  int ret;

  req.method = HTTP_GET;
  req.url = url;
  req.host = hostname;
  req.protocol = "HTTP/1.1";
  req.response = http_response_cb;
  req.recv_buf = recv_buf;
  req.recv_buf_len = sizeof(recv_buf);

  /* sock is a file descriptor referencing a socket that has been connected
  * to the HTTP server.
  */
  ret = http_client_req(sock, &req, 5000, NULL);
}
```

## src/http_get.h
```c
#include <stdio.h>
#include <stdlib.h>
#include <zephyr/net/socket.h>

void nslookup(const char * hostname, struct zsock_addrinfo **results);
void print_addrinfo_results(struct zsock_addrinfo *rp);
void http_get(int sock, char * hostname, char * url);
int connect_socket(struct zsock_addrinfo **results);
```

## src/nvs_config.c
```c
/*
 * NVS Sample for Zephyr using high level API, the sample illustrates the usage
 * of NVS for storing data of different kind (strings, binary blobs, unsigned
 * 32 bit integer) and also how to read them back from flash. The reading of
 * data is illustrated for both a basic read (latest added value) as well as
 * reading back the history of data (previously added values). Next to reading
 * and writing data it also shows how data can be deleted from flash.
 *
 * The sample stores the following items:
 * 1. A string representing an IP-address: stored at id=1, data="192.168.1.1"
 * 2. A binary blob representing a key: stored at id=2, data=FF FE FD FC FB FA
 *    F9 F8
 * 3. A reboot counter (32bit): stored at id=3, data=reboot_counter
 * 4. A string: stored at id=4, data="DATA" (used to illustrate deletion of
 * items)
 *
 * At first boot the sample checks if the data is available in flash and adds
 * the items if they are not in flash.
 *
 * Every reboot increases the values of the reboot_counter and updates it in
 * flash.
 *
 * At the 10th reboot the string item with id=4 is deleted (or marked for
 * deletion).
 *
 * At the 11th reboot the string item with id=4 can no longer be read with the
 * basic nvs_read() function as it has been deleted. It is possible to read the
 * value with nvs_read_hist()
 *
 * At the 78th reboot the first sector is full and a new sector is taken into
 * use. The data with id=1, id=2 and id=3 is copied to the new sector. As a
 * result of this the history of the reboot_counter will be removed but the
 * latest values of address, key and reboot_counter is kept.
 *
 * Copyright (c) 2018 Laczen
 *
 * SPDX-License-Identifier: Apache-2.0
 */


#include <zephyr/kernel.h>
#include <zephyr/sys/reboot.h>
#include <zephyr/device.h>
#include <zephyr/drivers/flash.h>
#include <zephyr/storage/flash_map.h>
#include <zephyr/fs/nvs.h>
#include <zephyr/settings/settings.h>

struct nvs_fs my_config_nvs;

#define NVS_PARTITION		storage_partition
#define NVS_PARTITION_DEVICE	FIXED_PARTITION_DEVICE(NVS_PARTITION)
#define NVS_PARTITION_OFFSET	FIXED_PARTITION_OFFSET(NVS_PARTITION)

int init_nvs(void)
{
	int rc = 0;
	struct flash_pages_info info;

	my_config_nvs.flash_device = NVS_PARTITION_DEVICE;
	if (!device_is_ready(my_config_nvs.flash_device)) {
		printk("Flash device %s is not ready\n", my_config_nvs.flash_device->name);
		return 1;
	}
	my_config_nvs.offset = NVS_PARTITION_OFFSET;
	rc = flash_get_page_info_by_offs(my_config_nvs.flash_device, my_config_nvs.offset, &info);
	if (rc) {
		printk("Unable to get page info\n");
		return 1;
	}
	my_config_nvs.sector_size = info.size;
	my_config_nvs.sector_count = 16U;

	rc = nvs_mount(&my_config_nvs);
	if (rc) {
		printk("Flash Init failed\n");
        return 1;
	}

    settings_subsys_init();
    settings_load();

    printk("NVS initialized\n");
    return 0;
}
```

## src/nvs_config.h
```c
#pragma once

#include <zephyr/fs/nvs.h>

extern struct nvs_fs my_config_nvs;
int init_nvs(void);
```

## src/wifi.c
```c
/*
 * Copyright (c) 2023 Craig Peacock.
 * Copyright (c) 2017 ARM Ltd.
 * Copyright (c) 2016 Intel Corporation.
 *
 * SPDX-License-Identifier: Apache-2.0
 */

#include "wifi.h"
#include <zephyr/kernel.h>
#include <zephyr/net/net_event.h>
#include <zephyr/net/net_if.h>
#include <zephyr/net/wifi_mgmt.h>

// For simplicity, assume only 1 WiFi net_if.
static K_SEM_DEFINE(sem_wifi_connected, 0, 1);
static K_SEM_DEFINE(sem_have_ip_address, 0, 1);
static bool wifi_connected, have_ip_address;

static void handle_wifi(struct net_mgmt_event_callback* cb, uint32_t mgmt_event, struct net_if* iface)
{
    const struct wifi_status* status = (const struct wifi_status*)cb->info;
    switch (mgmt_event) {
    case NET_EVENT_WIFI_CONNECT_RESULT:
        if (status->conn_status <= WIFI_STATUS_CONN_SUCCESS) {
            printk("NET: WiFi is now connected.");
            wifi_connected = true;
        } else {
            wifi_connected = false;
            printk("NET: Connecting to WiFi failed (%d)\n", status->conn_status);
        }
        k_sem_give(&sem_wifi_connected);
        break;
    case NET_EVENT_WIFI_DISCONNECT_RESULT:
        wifi_connected = false;
        printk("NET: WiFi disconnected\n");
        break;
    }
}

static void handle_net(struct net_mgmt_event_callback* cb, uint32_t mgmt_envt, struct net_if* iface)
{
    const struct wifi_status* status = (const struct wifi_status*)cb->info;
    switch (mgmt_envt) {
    case NET_EVENT_IPV4_ADDR_ADD:
    case NET_EVENT_IPV6_ADDR_ADD: {
        printk("NET: IP Address acquired. Find me at the following addresses:\n");

        for (int i = 0; i < NET_IF_MAX_IPV4_ADDR; i++) {
            char buf_addr[NET_IPV4_ADDR_LEN], buf_gw[NET_IPV4_ADDR_LEN];
            net_addr_ntop(AF_INET,
                &iface->config.ip.ipv4->unicast[i].ipv4.address.in_addr,
                buf_addr, sizeof(buf_addr));
            net_addr_ntop(AF_INET,
                &iface->config.ip.ipv4->gw,
                buf_gw, sizeof(buf_gw));
            printk("- IPv4 %s (via Gateway %s)\n", buf_addr, buf_gw);
        }

        have_ip_address = true;
        // FIXME: race condition, needs to be reset every time before we request a connect.
        // FIXME: something condvar.
        k_sem_give(&sem_have_ip_address);
    }
    }
}

int wifi_connect(struct my_config_wifi_entry* config)
{
    struct net_if* iface = net_if_get_first_wifi();

    struct wifi_connect_req_params wifi_params = { 0 };
    wifi_params.ssid = config->ssid;
    wifi_params.psk = config->psk;
    wifi_params.ssid_length = config->ssid_len;
    wifi_params.psk_length = config->psk_len;
    wifi_params.channel = WIFI_CHANNEL_ANY;
    wifi_params.security = WIFI_SECURITY_TYPE_PSK;
    wifi_params.band = WIFI_FREQ_BAND_2_4_GHZ;
    wifi_params.mfp = WIFI_MFP_OPTIONAL;

    printk("Connecting to SSID...: %s\n", wifi_params.ssid);

    if (net_mgmt(NET_REQUEST_WIFI_CONNECT, iface, &wifi_params, sizeof(struct wifi_connect_req_params))) {
        printk("WiFi Connection Request Failed\n");
        return 1;
    }
    k_sem_take(&sem_wifi_connected, K_FOREVER);
    if (!wifi_connected) {
        // We already got an error message
        return 1;
    }

    k_sem_take(&sem_have_ip_address, K_SECONDS(30));
    if (!have_ip_address) {
        printk("Obtaining an IP address took too long. Is the Router configured correctly?\n");
    }

    return 0;
}

int init_wifi(void)
{
    static struct net_mgmt_event_callback handle_wifi_cb, handle_net_cb;
    net_mgmt_init_event_callback(&handle_wifi_cb, handle_wifi,
        NET_EVENT_WIFI_CONNECT_RESULT | NET_EVENT_WIFI_DISCONNECT_RESULT);
    net_mgmt_init_event_callback(&handle_net_cb, handle_net,
        NET_EVENT_IPV4_ADDR_ADD);
    net_mgmt_add_event_callback(&handle_wifi_cb);
    net_mgmt_add_event_callback(&handle_net_cb);
    printk("Init Done: WiFi\n");

    return 0;
}
```

## src/wifi.h
```c
#pragma once

#include <stdint.h>

struct my_config_wifi_entry {
    uint8_t sec_type;
    uint8_t psk_len, ssid_len;
    uint8_t ssid[32];
    uint8_t psk[64];
};

int wifi_connect(struct my_config_wifi_entry *config);
int init_wifi(void);

// Tries to connect to the WiFi. If we succeed, save it.
int wifi_add(struct my_config_wifi_entry* config);
```
